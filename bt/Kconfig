## bt/Kconfig
```kconfig
# Copyright (c) 2025 Ovyl
# SPDX-License-Identifier: Apache-2.0

menuconfig ZMOD_BT
    bool "Zmod BT Module"
    depends on BT && BT_PERIPHERAL
    select BT_CONN
    default n
    help
      Enable the Zmod Bluetooth module for BLE peripheral functionality
      with configurable advertising and connection management.

if ZMOD_BT

# Advertising configuration
config ZMOD_BT_ADV_FLAGS
    hex "BLE Advertising Flags"
    default 0x06
    help
      Bluetooth advertising flags. Default is 0x06 (BT_LE_AD_GENERAL | BT_LE_AD_NO_BREDR).
      BT_LE_AD_GENERAL = 0x02
      BT_LE_AD_NO_BREDR = 0x04

config ZMOD_BT_ADV_CONNECTABLE
    bool "Enable connectable advertising"
    default y
    help
      Enable BLE connectable advertising mode

config ZMOD_BT_ADV_INTERVAL_MIN
    int "Minimum advertising interval (in 0.625ms units)"
    default 1600
    range 32 16384
    help
      Minimum advertising interval in 0.625ms units.
      Default is 1600 (1 second). Range: 20ms to 10.24s.

config ZMOD_BT_ADV_INTERVAL_MAX
    int "Maximum advertising interval (in 0.625ms units)"
    default 2400
    range 32 16384
    help
      Maximum advertising interval in 0.625ms units.
      Default is 2400 (1.5 seconds). Range: 20ms to 10.24s.

config ZMOD_BT_ADV_AUTO_START
    bool "Auto-start BLE advertising on initialization"
    default y
    help
      Automatically start BLE advertising when the BT module is initialized.
      If disabled, the application must manually call ble_core_start_advertising().

config ZMOD_BT_ADV_RESTART_ON_DISCONNECT
    bool "Auto-restart advertising after disconnect"
    default y
    help
      Automatically restart BLE advertising when a device disconnects.
      If disabled, advertising must be manually restarted after disconnection.

config ZMOD_BT_ADV_ID
    int "Bluetooth identity ID for advertising"
    default 0
    range 0 15
    help
      The Bluetooth identity to use for advertising (BT_ID_DEFAULT = 0).
      Allows using different identities for different advertising sets.

config ZMOD_BT_ZBUS_PUBLISH
    bool "Publish BT connection events via Zbus"
    depends on ZBUS
    default y
    help
      Publish Bluetooth connection and disconnection events to Zbus channel.
      Allows other modules to subscribe to BT connection state changes.

config ZMOD_BT_SHELL_CMDS
    bool "Enable shell commands for BT module"
    depends on SHELL
    default y
    help
      Enable shell commands for controlling the BT module (advertising,
      connection management, status). Commands are available under 'zmod_bt'.

config ZMOD_BT_SHELL
    bool "Enable shell over Bluetooth (NUS)"
    default n
    select SHELL_BT_NUS
    select LOG_CMDS
    help
      Enable shell over Bluetooth which provides BLE shell transport via Nordic UART Service (NUS).

endif # ZMOD_BT

# Pattern for per-module logging config
module = ZMOD_BT
module-str = ZMOD_BT
source "subsys/logging/Kconfig.template.log_config"
```

## config/Kconfig
```kconfig
# Copyright (c) 2025 Ovyl
# SPDX-License-Identifier: Apache-2.0

menu "Zmod Config Module"

config ZMOD_CONFIG
    bool "Config Module"
    default n
    select NVS
    select FLASH
    select FLASH_MAP

config ZMOD_CONFIG_APP_DEF_PATH
    string "Path to app configs.def"
    help
      Path to the application’s CFG(...) file.
      Example:
        CONFIGS_APP_DEF_PATH="\"${CMAKE_CURRENT_SOURCE_DIR}/app/app_configs.def\""

config ZMOD_CONFIG_USE_CUSTOM_TYPES
    bool "Use custom config types"
    default n
    help
      Enable if the application uses custom config types defined
      in a separate header file.

config ZMOD_CONFIG_TYPES_DEF_PATH
    string "Path to app custom type header file"
    help
      Path to the application’s custom config types header file.
      Example:
        CONFIGS_APP_DEF_PATH="\"${CMAKE_CURRENT_SOURCE_DIR}/app/app_configs.def\""

# Pattern for per-module logging config
module = ZMOD_CFG_MGR
module-str = ZMOD_CFG_MGR
source "subsys/logging/Kconfig.template.log_config"


endmenu
```

## iwdog/Kconfig
```kconfig
# Copyright (c) 2025 Ovyl
# SPDX-License-Identifier: Apache-2.0

menu "Zmod Internal Watchdog"

config ZMOD_IWDOG
    bool "Internal Watchdog Support"
    default n
    select WATCHDOG

config ZMOD_WATCHDOG_FEED_INTERVAL_MS
    int "Watchdog feed interval (ms)"
    range 50 60000
    default 1000
    depends on ZMOD_IWDOG
    help
      Interval in milliseconds at which the watchdog is fed.
      Must be smaller than the actual watchdog timeout.

config ZMOD_WATCHDOG_TIMEOUT_MS
    int "Watchdog timeout (ms)"
    range 100 120000
    default 5000
    depends on ZMOD_IWDOG
    help
      Timeout in milliseconds for the watchdog. If not fed, system resets.

config ZMOD_IWDOG_THREAD_STACK_SIZE
    int "Zmod IWDOG thread stack size"
    default 1024
    range 256 8192
    depends on ZMOD_IWDOG
    help
      Stack size in bytes for the IWDOG service thread.

config ZMOD_IWDOG_THREAD_PRIORITY
    int "Zmod IWDOG thread priority"
    default 0
    range -16 15
    depends on ZMOD_IWDOG
    help
      Thread priority for the IWDOG service thread.
      Lower values = higher priority.


config ZMOD_IWDOG_WARNING_PCT
    int "Warn when this percent of timeout has elapsed"
    default 75
    range 1 99
    depends on ZMOD_IWDOG
    help
      Example: 75 means warn at 75% of the timeout (25% remaining).

config ZMOD_IWDOG_AUTO_START_THREAD
    bool "Auto-start Zmod IWDOG feed thread"
    default y
    depends on ZMOD_IWDOG
    help
      Automatically start the watchdog feeding thread during initialization.
      If disabled, the application must manually call zmod_iwdog_start_service_thread().

config ZMOD_IWDOG_ZBUS_PUBLISH
    bool "Publish imminent-reset warnings via Zbus"
    default y
    depends on ZMOD_IWDOG && ZBUS
    help
      Publish watchdog reset imminent warnings to Zbus channel.
      Allows other modules to subscribe to watchdog warning events.

config ZMOD_IWDOG_LOG_PANIC_ON_WARNING
    bool "Force immediate log flush on watchdog warning"
    default n
    depends on ZMOD_IWDOG
    help
      Calls LOG_PANIC() shortly before reset to flush logs. Increases latency.

config ZMOD_IWDOG_LOG_PANIC_THRESHOLD_MS
    int "Threshold before reset to call LOG_PANIC"
    default 250
    range 0 5000
    depends on ZMOD_IWDOG_LOG_PANIC_ON_WARNING
    help
      Milliseconds before watchdog reset to call LOG_PANIC().
      LOG_PANIC() forces synchronous log output to ensure messages are flushed.


# Pattern for per-module logging config
module = ZMOD_IWDOG
module-str = ZMOD_IWDOG
source "subsys/logging/Kconfig.template.log_config"


endmenu
```

## logging/Kconfig
```kconfig
# Copyright (c) 2025 Ovyl
# SPDX-License-Identifier: Apache-2.0

menu "Zmod Logging Module"

config ZMOD_LOG_STORAGE
    bool "Flash log storage backend"
    default n
    depends on ZMOD_CONFIG
    select FCB
    select FLASH
    select FLASH_MAP
    help
      Enable the Zmod flash log storage module, which records log output
      to an FCB partition and exposes shell helpers for exporting logs.

config ZMOD_LOG_STORAGE_MIN_RUNTIME_LEVEL
    int "Minimum runtime log level"
    range 1 4
    default 1
    help
      Lowest severity that can be selected at runtime. The module clamps
      requested values below this level to ensure critical logs stay visible.

config ZMOD_LOG_STORAGE_BUFFER_SIZE
    int "Flash log export buffer size"
    default 1024
    range 256 16384
    depends on ZMOD_LOG_STORAGE
    help
      Size in bytes of the temporary buffer used when formatting log entries
      for flash storage. Increase if exported records are truncated.

module = ZMOD_LOG_STORAGE
module-str = ZMOD_LOG_STORAGE
source "subsys/logging/Kconfig.template.log_config"

endmenu
```

## zephyr/Kconfig
```kconfig
# Copyright (c) 2025 Ovyl
# SPDX-License-Identifier: Apache-2.0

menu "Zmod Modules"

rsource "../bt/Kconfig"
rsource "../config/Kconfig"
rsource "../iwdog/Kconfig"
rsource "../logging/Kconfig"

endmenu
```
